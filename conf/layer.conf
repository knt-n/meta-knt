## conf/layer.conf
```bitbake
# We have a conf and classes directory, add to BBPATH
BBPATH .= ":${LAYERDIR}"

# We have recipes-* directories, add to BBFILES
BBFILES += "${LAYERDIR}/recipes-*/*/*.bb \
            ${LAYERDIR}/recipes-*/*/*.bbappend"

BBFILE_COLLECTIONS += "meta-knt"
BBFILE_PATTERN_meta-knt = "^${LAYERDIR}/"
BBFILE_PRIORITY_meta-knt = "6"

LAYERDEPENDS_meta-knt = "core"
LAYERSERIES_COMPAT_meta-knt = "hardknott"
```
